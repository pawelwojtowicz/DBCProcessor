VERSION "cascadeLvl2b"

BO_ 15729664 REPLACEMENT: 8 [sender]
 SG_ VehicleSpeed : 24|16@1+ (0.125,0) [0|8031.875] "kmPerHour" [receiver]

BA_ "ProtocolType" "J1939";
