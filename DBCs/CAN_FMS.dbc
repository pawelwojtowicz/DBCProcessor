BO_ 16612608 FMS1: 8 Vector__XXX
 SG_ TellTaleBlockId M : 0|4@0+ (1,0) [0|15] "" Vector__XXX
 SG_ 01_CollingAirConditioning m0 : 4|3@0+ (1,0) [0|7] "" Vector__XXX
 SG_ 02_HighbeamMainbeam m0 : 8|3@0+ (1,0) [0|7] "" Vector__XXX
 SG_ 03_LowbeamDippedbeam m0 : 12|3@0+ (1,0) [0|7] "" Vector__XXX
 SG_ 04_TurnSignals m0 : 16|3@0+ (1,0) [0|7] "" Vector__XXX
 SG_ 05_HazardWarning m0 : 20|3@0+ (1,0) [0|7] "" Vector__XXX
 SG_ 06_ProvisionForDisabled m0 : 24|3@0+ (1,0) [0|7] "" Vector__XXX
 SG_ 07_ParkingBrake m0 : 28|3@0+ (1,0) [0|7] "" Vector__XXX
 SG_ 08_BrakeSystemMalfunction m0 : 32|3@0+ (1,0) [0|7] "" Vector__XXX
 SG_ 09_HatchOpen m0 : 36|3@0+ (1,0) [0|7] "" Vector__XXX
 SG_ 10_FuelLevel m0 : 40|3@0+ (1,0) [0|7] "" Vector__XXX
 SG_ 11_EngineCoolantTemperature m0 : 44|3@0+ (1,0) [0|7] "" Vector__XXX
 SG_ 12_BatteryCharging m0 : 48|3@0+ (1,0) [0|7] "" Vector__XXX
 SG_ 13_EngineOil m0 : 52|3@0+ (1,0) [0|7] "" Vector__XXX
 SG_ 14_PositionLights m0 : 56|3@0+ (1,0) [0|7] "" Vector__XXX
 SG_ 15_FrontFogLights m0 : 60|3@0+ (1,0) [0|7] "" Vector__XXX
 SG_ 16_ReadFogLights m1 : 4|3@0+ (1,0) [0|7] "" Vector__XXX
 SG_ 17_ParkHeating m1 : 8|3@0+ (1,0) [0|7] "" Vector__XXX
 SG_ 18_EngineIndicator m1 : 12|3@0+ (1,0) [0|7] "" Vector__XXX
 SG_ 19_ServiceCall m1 : 16|3@0+ (1,0) [0|7] "" Vector__XXX
 SG_ 20_TransmissionFluidTemperature m1 : 20|3@0+ (1,0) [0|7] "" Vector__XXX
 SG_ 21_TransmissionMalfunction m1 : 24|3@0+ (1,0) [0|7] "" Vector__XXX
 SG_ 22_ABSFailure m1 : 28|3@0+ (1,0) [0|7] "" Vector__XXX
 SG_ 23_WornBreakLinings m1 : 32|3@0+ (1,0) [0|7] "" Vector__XXX
 SG_ 24_WindshieldFluid m1 : 36|3@0+ (1,0) [0|7] "" Vector__XXX
 SG_ 25_TireMalfunction m1 : 40|3@0+ (1,0) [0|7] "" Vector__XXX
 SG_ 26_GeneralFailure m1 : 44|3@0+ (1,0) [0|7] "" Vector__XXX
 SG_ 27_EngineOilTemperature m1 : 48|3@0+ (1,0) [0|7] "" Vector__XXX
 SG_ 28_EngineOilLevel m1 : 52|3@0+ (1,0) [0|7] "" Vector__XXX
 SG_ 29_EngineCoolantLevel m1 : 56|3@0+ (1,0) [0|7] "" Vector__XXX
 SG_ 30_SteeringFluidLevel m1 : 60|3@0+ (1,0) [0|7] "" Vector__XXX
 SG_ 31_SteeringFailure m2 : 4|3@0+ (1,0) [0|7] "" Vector__XXX
 SG_ 32_Leveling m2 : 8|3@0+ (1,0) [0|7] "" Vector__XXX
 SG_ 33_Retarder m2 : 12|3@0+ (1,0) [0|7] "" Vector__XXX
 SG_ 34_EngineEmissionSystemFailure m2 : 16|3@0+ (1,0) [0|7] "" Vector__XXX
 SG_ 35_ESC m2 : 20|3@0+ (1,0) [0|7] "" Vector__XXX
 SG_ 36_BrakeLights m2 : 24|3@0+ (1,0) [0|7] "" Vector__XXX
 SG_ 37_Articulation m2 : 28|3@0+ (1,0) [0|7] "" Vector__XXX
 SG_ 38_StopRequest m2 : 32|3@0+ (1,0) [0|7] "" Vector__XXX
 SG_ 39_PramRequest m2 : 36|3@0+ (1,0) [0|7] "" Vector__XXX
 SG_ 40_BusStopBrake m2 : 40|3@0+ (1,0) [0|7] "" Vector__XXX
 SG_ 41_AdBlueLevel m2 : 44|3@0+ (1,0) [0|7] "" Vector__XXX
 SG_ 42_Raising m2 : 48|3@0+ (1,0) [0|7] "" Vector__XXX
 SG_ 43_Lowering m2 : 52|3@0+ (1,0) [0|7] "" Vector__XXX
 SG_ 44_Kneeling m2 : 56|3@0+ (1,0) [0|7] "" Vector__XXX
 SG_ 45_EngineCompartmentTemperature m2 : 60|3@0+ (1,0) [0|7] "" Vector__XXX
 SG_ 46_AuxillaryAirPressure m3 : 4|3@0+ (1,0) [0|7] "" Vector__XXX
 SG_ 47_AirFilterClogged m3 : 8|3@0+ (1,0) [0|7] "" Vector__XXX
 SG_ 48_FuelFilterDifferentialPressure m3 : 12|3@0+ (1,0) [0|7] "" Vector__XXX
 SG_ 49_SeatBelt m3 : 16|3@0+ (1,0) [0|7] "" Vector__XXX
 SG_ 50_EBS m3 : 20|3@0+ (1,0) [0|7] "" Vector__XXX
 SG_ 51_LaneDepartureIndication m3 : 24|3@0+ (1,0) [0|7] "" Vector__XXX
 SG_ 52_AdvancedEmergencyBreakingSystem m3 : 28|3@0+ (1,0) [0|7] "" Vector__XXX
 SG_ 53_ACC m3 : 32|3@0+ (1,0) [0|7] "" Vector__XXX
 SG_ 54_TrailerConnected m3 : 36|3@0+ (1,0) [0|7] "" Vector__XXX
 SG_ 55_ABSTrailer m3 : 40|3@0+ (1,0) [0|7] "" Vector__XXX
 SG_ 56_Airbag m3 : 44|3@0+ (1,0) [0|7] "" Vector__XXX
 SG_ 57_EBSTrailer m3 : 48|3@0+ (1,0) [0|7] "" Vector__XXX
 SG_ 58_Tachograph m3 : 52|3@0+ (1,0) [0|7] "" Vector__XXX
 SG_ 59_ESCSwitchedOff m3 : 56|3@0+ (1,0) [0|7] "" Vector__XXX
 SG_ 60_LaneDepartureWarningOff m3 : 60|3@0+ (1,0) [0|7] "" Vector__XXX
 SG_ 61_EngineEmissionFilter m4 : 4|3@0+ (1,0) [0|7] "" Vector__XXX
 SG_ 62_ElectricMotorFailure m4 : 8|3@0+ (1,0) [0|7] "" Vector__XXX
 SG_ 63_AdBlueTampering m4 : 12|3@0+ (1,0) [0|7] "" Vector__XXX
 SG_ 64_MultiplexSystem m4 : 16|3@0+ (1,0) [0|7] "" Vector__XXX
 SG_ 65_BatteryPack m4 : 20|3@0+ (1,0) [0|7] "" Vector__XXX
 SG_ 66_HighVoltageSystemCaution m4 : 24|3@0+ (1,0) [0|7] "" Vector__XXX
 SG_ 67_BatteryPackTemperature m4 : 28|3@0+ (1,0) [0|7] "" Vector__XXX
 SG_ 68_LimitedPerformanceElectricMotor m4 : 32|3@0+ (1,0) [0|7] "" Vector__XXX
 SG_ 69_BatteryPackCooling m4 : 36|3@0+ (1,0) [0|7] "" Vector__XXX
 SG_ 70_Reserved m4 : 40|3@0+ (1,0) [0|7] "" Vector__XXX
 SG_ 71_Reserved m4 : 44|3@0+ (1,0) [0|7] "" Vector__XXX
 SG_ 72_Reserved m4 : 48|3@0+ (1,0) [0|7] "" Vector__XXX
 SG_ 73_Reserved m4 : 52|3@0+ (1,0) [0|7] "" Vector__XXX
 SG_ 74_Reserved m4 : 56|3@0+ (1,0) [0|7] "" Vector__XXX
 SG_ 75_Reserved m4 : 60|3@0+ (1,0) [0|7] "" Vector__XXX
